## make/libs/libdvbpsi/Config.in
```kconfig
config FREETZ_LIB_libdvbpsi
	bool "libdvbpsi (libdvbpsi.so)"
	default n
	help
	  libdvbpsi is a simple library designed for decoding and
	  generation of MPEG TS and DVB PSI tables according to standards
	  ISO/IEC 13818 and ITU-T H.222.0.

	  http://www.videolan.org/developers/libdvbpsi.html
```

## make/tvheadend/Config.in
```kconfig
config FREETZ_PACKAGE_TVHEADEND
	bool "tvheadend 4"
	select FREETZ_PACKAGE_PYTHON
	select FREETZ_BUSYBOX_BZIP2
	select FREETZ_BUSYBOX_GZIP
	select FREETZ_PACKAGE_OPENSSL
	default n
```

## make/vlc/Config.in
```kconfig
config FREETZ_PACKAGE_VLC
	bool "vlc 2.2.3"
	select FREETZ_BUSYBOX_BZIP2
	select FREETZ_BUSYBOX_GZIP
	select FREETZ_PACKAGE_OPENSSL
	default n
```
